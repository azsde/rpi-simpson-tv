## conf/layer.conf
```bitbake
# We have a conf and classes directory, add to BBPATH
BBPATH .= ":${LAYERDIR}"

# We have recipes-* directories, add to BBFILES
BBFILES += "${LAYERDIR}/recipes-*/*/*.bb \
            ${LAYERDIR}/recipes-*/*/*.bbappend"

BBFILE_COLLECTIONS += "meta-simpson-tv"
BBFILE_PATTERN_meta-simpson-tv = "^${LAYERDIR}/"
BBFILE_PRIORITY_meta-simpson-tv = "6"

LAYERDEPENDS_meta-simpson-tv = "core"
LAYERSERIES_COMPAT_meta-simpson-tv = "kirkstone"
```
